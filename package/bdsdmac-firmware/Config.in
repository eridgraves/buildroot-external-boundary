## package/bdsdmac-firmware/Config.in
```kconfig
menuconfig BR2_PACKAGE_BDSDMAC_FIRMWARE
	bool "bdsdmac-firmware"
	help
	  This module adds firmware files for the BDSDMAC Wi-Fi/BT module.
```

## package/if573-sdio-firmware/Config.in
```kconfig
menuconfig BR2_PACKAGE_IF573_SDIO_FIRMWARE
	bool "if573-sdio-firmware"
	help
	  This module adds firmware files for the IF573 Wi-Fi/BT module.
```

## package/kernel-module-bdsdmac-backports/Config.in
```kconfig
comment "kernel-module-bdsdmac-backports needs a Linux kernel to be built"
	depends on !BR2_LINUX_KERNEL

menuconfig BR2_PACKAGE_KERNEL_MODULE_BDSDMAC_BACKPORTS
	bool "kernel module bdsdmac backports"
	depends on BR2_LINUX_KERNEL
	help
	  This kernel module adds support for Laird Backports for
	  the following Wifi/BT Modules: BD-SDMAC, IFxxx, and LWBxx.
```

## package/lwb5plus-sdio-sa-firmware/Config.in
```kconfig
menuconfig BR2_PACKAGE_LWB5PLUS_SDIO_SA_FIRMWARE
	bool "lwb5plus-sdio-sa-firmware"
	help
	  This module adds firmware files for the LWB5+ Wi-Fi/BT module.
```
